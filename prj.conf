## CMakeLists.txt
```
cmake_minimum_required(VERSION 3.20.0)

macro(app_set_runner_args)
#   board_runner_args(dfu-util "--dfuse-modifiers=force:mass-erase")
#   board_runner_args(pyocd "--erase")
#   board_runner_args(nrfjprog "--recover")
endmacro()

find_package(Zephyr REQUIRED HINTS $ENV{ZEPHYR_BASE})
project(nvs)


target_sources(app PRIVATE src/main.c src/BoardConfigs.c)
target_include_directories(app PRIVATE ${ZEPHYR_BASE}/subsys/fs/nvs)
```

## prj.conf
```kconfig
CONFIG_FLASH=y
CONFIG_FLASH_PAGE_LAYOUT=y

CONFIG_NVS=y
CONFIG_LOG=y
CONFIG_NVS_LOG_LEVEL_DBG=y
CONFIG_REBOOT=y
CONFIG_MPU_ALLOW_FLASH_WRITE=y

# Disable console.
CONFIG_CONSOLE=y
CONFIG_UART_CONSOLE=y
CONFIG_RTT_CONSOLE=y
CONFIG_STDOUT_CONSOLE=n
```

## src/main.c
```c
#include <string.h>
#include <zephyr/device.h>
#include <zephyr/drivers/flash.h>
#include <zephyr/fs/nvs.h>
#include <zephyr/kernel.h>
#include <zephyr/storage/flash_map.h>

#include "BoardConfigs.h"

static struct nvs_fs fs;

#define NVS_PARTITION storage_partition
#define NVS_PARTITION_DEVICE FIXED_PARTITION_DEVICE(NVS_PARTITION)
#define NVS_PARTITION_OFFSET FIXED_PARTITION_OFFSET(NVS_PARTITION)

#define NAME_ID 1
#define ROLE_ID 2
#define HW_ID 3
#define SW_ID 4
#define DATETIME_ID 5

void main(void) {
    int rc = 0;
    char buf[30];
    struct flash_pages_info info;

    struct BoardConfig brd;
    if (!get_board_config(brd_w2405_Rose, &brd)) {
        printk("Invalid board config");
        return;
    }

    const bool reset = false;

    fs.flash_device = NVS_PARTITION_DEVICE;
    if (!device_is_ready(fs.flash_device)) {
        printk("Flash device %s is not ready\n", fs.flash_device->name);
        return;
    }
    fs.offset = NVS_PARTITION_OFFSET;
    rc = flash_get_page_info_by_offs(fs.flash_device, fs.offset, &info);
    if (rc) {
        printk("Unable to get page info\n");
        return;
    }
    fs.sector_size = info.size;
    fs.sector_count = 3U;

    rc = nvs_mount(&fs);
    if (rc) {
        printk("Flash Init failed\n");
        return;
    }

    bool write;

    if (reset) {
        printk("Old flash entries will be deleted.\n");
        (void)nvs_delete(&fs, NAME_ID);
        (void)nvs_delete(&fs, ROLE_ID);
        (void)nvs_delete(&fs, HW_ID);
        (void)nvs_delete(&fs, SW_ID);
        (void)nvs_delete(&fs, DATETIME_ID);
    }

    rc = nvs_read(&fs, NAME_ID, &buf, sizeof(buf));
    if (rc > 0) {
        printk("Name: %s\n", buf);
        write = strcmp(buf, brd.name) != 0;
    } else {
        printk("Name not found.");
        write = true;
    }
    if (write) {
        printk("  -> Writing %s\n", brd.name);
        (void)nvs_write(&fs, NAME_ID, brd.name, strlen(brd.name) + 1);
    }

    rc = nvs_read(&fs, ROLE_ID, &buf, sizeof(buf));
    if (rc > 0) {
        printk("Role: %s\n", buf);
        write = strcmp(buf, brd.role) != 0;
    } else {
        printk("Role not found.");
        write = true;
    }
    if (write) {
        printk("  -> Writing %s\n", brd.role);
        (void)nvs_write(&fs, ROLE_ID, brd.role, strlen(brd.role) + 1);
    }

    rc = nvs_read(&fs, HW_ID, &buf, sizeof(buf));
    if (rc > 0) {
        printk("HW: %s\n", buf);
        write = strcmp(buf, brd.hw) != 0;
    } else {
        printk("HW not found.");
        write = true;
    }
    if (write) {
        printk("  -> Writing %s\n", brd.hw);
        (void)nvs_write(&fs, HW_ID, brd.hw, strlen(brd.hw) + 1);
    }

    rc = nvs_read(&fs, SW_ID, &buf, sizeof(buf));
    if (rc > 0) {
        printk("SW: %s\n", buf);
        write = strcmp(buf, brd.sw) != 0;
    } else {
        printk("SW not found.");
        write = true;
    }
    if (write) {
        printk("  -> Writing %s\n", brd.sw);
        (void)nvs_write(&fs, SW_ID, brd.sw, strlen(brd.sw) + 1);
    }

    rc = nvs_read(&fs, DATETIME_ID, &buf, sizeof(buf));
    if (rc > 0) {
        printk("Date/time: %s\n", buf);
        write = strcmp(buf, brd.dt) != 0;
    } else {
        printk("Date/time not found.");
        write = true;
    }
    if (write) {
        printk("  -> Writing %s\n", brd.dt);
        (void)nvs_write(&fs, DATETIME_ID, brd.dt, strlen(brd.dt) + 1);
    }

    uint32_t zero = 0;
    nvs_write(&fs, 6, "NA", 2);
    nvs_write(&fs, 7, &zero, sizeof(zero));
    nvs_write(&fs, 8, &zero, sizeof(zero));
    nvs_write(&fs, 9, &zero, sizeof(zero));

    printk("All done!");
}
```

## src/BoardConfigs.c
```c
#include "BoardConfigs.h"

#define MaxConfigs 4
bool get_board_config(const uint8_t board, struct BoardConfig* config) {
    switch (board) {
        // w8/h1/r2 variety set
        case brd_w8_Thistle:
            *config = (struct BoardConfig){
                .name = "Posey w8 Thistle",
                .role = "watch",
                .hw = "v8.1",
                .sw = "1.1.0",
                .dt = "2023-02-06 15:24 EST"};
            return true;

        case brd_h1_Flox:
            *config = (struct BoardConfig){
                .name = "Posey h1 Flox",
                .role = "watch",
                .hw = "v8.1",
                .sw = "1.1.0",
                .dt = "2023-02-06 15:24 EST"};
            return true;

        case brd_r2_Tulip:
            *config = (struct BoardConfig){
                .name = "Posey r2 Tulip",
                .role = "ring",
                .hw = "r2.1",
                .sw = "1.1.0",
                .dt = "2023-02-06 15:24 EST"};
            return true;

        case brd_h1_Carnation:
            *config = (struct BoardConfig){
                .name = "Posey h1 Carnation",
                .role = "hub",
                .hw = "h1v8.1",
                .sw = "1.1.0",
                .dt = "2023-02-06 15:24 EST"};
            return true;

        // w8.2 r2.2
        case brd_r2_Indigo:
            *config = (struct BoardConfig){
                .name = "Posey r2 Indigo",
                .role = "ring",
                .hw = "r2.2",
                .sw = "1.1.0",
                .dt = "2023-05-24 15:24 EST"};
            return true;

        case brd_h1_Aster:
            *config = (struct BoardConfig){
                .name = "Posey h1 Aster",
                .role = "hub",
                .hw = "h1v8.2",
                .sw = "1.1.0",
                .dt = "2023-05-24 15:24 EST"};
            return true;

        // x2310
        case brd_w2310_Iris:
            *config = (struct BoardConfig){
                .name = "Posey r2310 Iris",
                .role = "ring",
                .hw = "r2310",
                .sw = "1.2.0",
                .dt = "2024-01-20 18:00 EST"};

        // x2405
        case brd_w2405_Lily:
            *config = (struct BoardConfig){
                .name = "Posey r2405 Lily",
                .role = "ring",
                .hw = "r2405",
                .sw = "1.3.0",
                .dt = "2024-06-14 18:00 EST"};
            return true;
        case brd_w2405_Poppy:
            *config = (struct BoardConfig){
                .name = "Posey r2405 Poppy",
                .role = "ring",
                .hw = "r2405",
                .sw = "1.3.0",
                .dt = "2024-06-21 18:00 EST"};
            return true;
        case brd_w2405_Violet:
            *config = (struct BoardConfig){
                .name = "Posey r2405 Violet",
                .role = "ring",
                .hw = "r2405",
                .sw = "1.3.0",
                .dt = "2024-06-24 18:00 EST"};
            return true;
        case brd_w2405_Rose:
            *config = (struct BoardConfig){
                .name = "Posey r2405 Rose",
                .role = "ring",
                .hw = "r2405",
                .sw = "1.3.0",
                .dt = "2024-06-24 18:00 EST"};
            return true;

        default:
            return false;
    }
}
```

## src/BoardConfigs.h
```c
#pragma once

#include <stdbool.h>
#include <stdint.h>

struct BoardConfig {
        const char* name;
        const char* role;
        const char* hw;
        const char* sw;
        const char* dt;
};

// w8.1/h1/r2.1 variety set
#define brd_w8_Thistle 0
#define brd_h1_Flox 1
#define brd_r2_Tulip 2
#define brd_h1_Carnation 3

// w8.2/r2.2 variety set
#define brd_r2_Indigo 4
#define brd_h1_Aster 5

// x2310
#define brd_w2310_Iris 6

// x2405
#define brd_w2405_Lily 7    // BNO086
#define brd_w2405_Poppy 8   // BNO086
#define brd_w2405_Violet 9  // BNO086
#define brd_w2405_Rose 10   // BNO085*

bool get_board_config(const uint8_t board, struct BoardConfig* config);
```
